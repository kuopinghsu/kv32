// ============================================================================
// File: sram_1rw.sv  (syn/lib)
// Project: KV32 RISC-V Processor — Synthesis Library
//
// Synthesis wrapper: maps the generic sram_1rw interface to OpenRAM hard
// macros generated by 'make gen-mem'.
//
// Default synthesis parameters (ICACHE_SIZE=4096, ICACHE_LINE_SIZE=32,
// ICACHE_WAYS=2) produce two SRAM configurations:
//
//   sram_1rw_64x21  – I-cache tag  SRAM  (NUM_SETS=64,  TAG_BITS=21)
//   sram_1rw_512x32 – I-cache data SRAM  (DATA_DEPTH=512, WIDTH=32)
//
// If cache parameters change, re-run:
//   make gen-mem [ICACHE_SIZE=N] [ICACHE_LINE_SIZE=N] [ICACHE_WAYS=N]
// and update the generate-block conditions below to match.
//
// OpenRAM port convention (num_rw_ports=1):
//   clk0  – rising-edge clock
//   csb0  – chip-select bar (active-low)
//   web0  – write-enable bar (active-low)
//   addr0 – word address
//   din0  – write data
//   dout0 – read data (registered, valid one cycle after access)
// ============================================================================

// This file replaces rtl/memories/sram_1rw.sv in the synthesis RTL file list.

module sram_1rw #(
    parameter int DEPTH = 256,
    parameter int WIDTH = 32
) (
    input  logic                     clk,
    input  logic                     ce,
    input  logic                     we,
    input  logic [$clog2(DEPTH)-1:0] addr,
    input  logic [WIDTH-1:0]         wdata,
    output logic [WIDTH-1:0]         rdata
);

generate
    // -----------------------------------------------------------------------
    // I-cache tag SRAM: 64 words × 21 bits
    // Matches default params ICACHE_SIZE=4096/LINE=32/WAYS=2 -> TAG_BITS=21
    // -----------------------------------------------------------------------
    if (DEPTH == 64 && WIDTH == 21) begin : g_tag_sram

        sram_1rw_64x21 u_mem (
            .clk0 (clk),
            .csb0 (~ce),
            .web0 (~we),
            .addr0(addr),
            .din0 (wdata),
            .dout0(rdata)
        );

    // -----------------------------------------------------------------------
    // I-cache data SRAM: 512 words × 32 bits
    // Matches default params -> DATA_SRAM_DEPTH = NUM_SETS*WPL = 64*8 = 512
    // -----------------------------------------------------------------------
    end else if (DEPTH == 512 && WIDTH == 32) begin : g_data_sram

        sram_1rw_512x32 u_mem (
            .clk0 (clk),
            .csb0 (~ce),
            .web0 (~we),
            .addr0(addr),
            .din0 (wdata),
            .dout0(rdata)
        );

    // -----------------------------------------------------------------------
    // Fallback: register-array model for any other (DEPTH, WIDTH) pair.
    // No timing characterization – synthesis tool will use default estimates.
    // Add a new generate branch and OpenRAM config if a new size is needed.
    // -----------------------------------------------------------------------
    end else begin : g_fallback

        logic [WIDTH-1:0] mem [0:DEPTH-1];

        always_ff @(posedge clk) begin
            if (ce) begin
                if (we) mem[addr] <= wdata;
                else    rdata     <= mem[addr];
            end
        end

    end
endgenerate

endmodule
