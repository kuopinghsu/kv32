## rtos/zephyr/Kconfig
```kconfig
# Copyright (c) 2026 kcore Project
# SPDX-License-Identifier: Apache-2.0

# Source board and SOC Kconfig files
osource "$(ZEPHYR_BASE)/../modules/*/boards/$(BOARD_DIR)/Kconfig"
osource "boards/$(BOARD_DIR)/Kconfig"

osource "$(ZEPHYR_BASE)/../modules/*/soc/$(SOC_FAMILY)/*/Kconfig"
osource "soc/$(SOC_FAMILY)/*/Kconfig"

# Source driver Kconfig files
rsource "drivers/*/Kconfig*"
```

## rtos/zephyr/boards/riscv/kcore_board/Kconfig.board
```kconfig
# Copyright (c) 2026 kcore Project
# SPDX-License-Identifier: Apache-2.0

config BOARD_KCORE_BOARD
    bool "kcore RISC-V Development Board"
    depends on SOC_RISCV_KCORE
    help
      Enable support for the kcore RISC-V development board.
      This board features:
      - RV32IM processor core
      - 2MB RAM
      - UART console
      - CLINT timer/interrupts
```

## rtos/zephyr/boards/riscv/kcore_board/Kconfig.defconfig
```kconfig
# Copyright (c) 2026 kcore Project
# SPDX-License-Identifier: Apache-2.0

if BOARD_KCORE_BOARD

config BOARD
    default "kcore_board"

# Disable UART console by default - use magic address console instead
config UART_CONSOLE
    default n

config SERIAL
    default n
# Timer configuration
config RISCV_MACHINE_TIMER
    default y if SYS_CLOCK_EXISTS

config SYS_CLOCK_HW_CYCLES_PER_SEC
    default 50000000

config SYS_CLOCK_TICKS_PER_SEC
    default 100
endif # BOARD_KCORE_BOARD
```

## rtos/zephyr/boards/riscv/kcore_board/kcore_board_defconfig
```kconfig
# Copyright (c) 2026 kcore Project
# SPDX-License-Identifier: Apache-2.0

# SoC configuration
CONFIG_SOC_RISCV_KCORE=y

# Serial and Console configuration
CONFIG_SERIAL=y
CONFIG_CONSOLE=y
CONFIG_CONSOLE_KCORE=y
CONFIG_PRINTK=y

# Minimal footprint
CONFIG_MINIMAL_LIBC=y
CONFIG_SIZE_OPTIMIZATIONS=y

# Stack sizes
CONFIG_MAIN_STACK_SIZE=2048
CONFIG_IDLE_STACK_SIZE=512
CONFIG_ISR_STACK_SIZE=2048
```

## rtos/zephyr/boards/riscv/kv32/Kconfig.board
```kconfig
# Copyright (c) 2026 kv32 Project
# SPDX-License-Identifier: Apache-2.0

config BOARD_KV32
    bool "kv32 RISC-V Development Board"
    depends on SOC_RISCV_KV32
    help
      Enable support for the kv32 RISC-V development board.
      This board features:
      - RV32IM processor core
      - 2MB RAM
      - UART console
      - CLINT timer/interrupts
```

## rtos/zephyr/boards/riscv/kv32/Kconfig.defconfig
```kconfig
# Copyright (c) 2026 kv32 Project
# SPDX-License-Identifier: Apache-2.0

if BOARD_KV32

config BOARD
    default "kv32"

# Disable UART console by default - use magic address console instead
config UART_CONSOLE
    default n

config SERIAL
    default n
# Timer configuration
config RISCV_MACHINE_TIMER
    default y if SYS_CLOCK_EXISTS

config SYS_CLOCK_HW_CYCLES_PER_SEC
    default 50000000

config SYS_CLOCK_TICKS_PER_SEC
    default 100
endif # BOARD_KV32
```

## rtos/zephyr/boards/riscv/kv32/kv32_defconfig
```kconfig
# Copyright (c) 2026 kv32 Project
# SPDX-License-Identifier: Apache-2.0

# SoC configuration
CONFIG_SOC_RISCV_KV32=y

# Serial and Console configuration
CONFIG_SERIAL=y
CONFIG_CONSOLE=y
CONFIG_CONSOLE_KV32=y
CONFIG_PRINTK=y

# Minimal footprint
CONFIG_MINIMAL_LIBC=y
CONFIG_SIZE_OPTIMIZATIONS=y

# Stack sizes
CONFIG_MAIN_STACK_SIZE=2048
CONFIG_IDLE_STACK_SIZE=512
CONFIG_ISR_STACK_SIZE=2048
```

## rtos/zephyr/drivers/Kconfig
```kconfig
# Copyright (c) 2026 kcore Project
# SPDX-License-Identifier: Apache-2.0

rsource "console/Kconfig*"
rsource "serial/Kconfig*"
```

## rtos/zephyr/drivers/console/Kconfig.kcore
```kconfig
# Copyright (c) 2026 kcore Project
# SPDX-License-Identifier: Apache-2.0

config CONSOLE_KCORE
    bool "kcore magic address console driver"
    help
      Enable console driver that writes to magic address 0xFFFFFFF4.
      This is useful for simulation/testbench where characters written
      to this address appear in the console output.

      This driver provides faster simulation performance compared to
      the full UART driver, as it bypasses hardware FIFO and baud rate
      timing simulation.

if CONSOLE_KCORE

config CONSOLE_INIT_PRIORITY
    default 40

endif # CONSOLE_KCORE
```

## rtos/zephyr/drivers/console/Kconfig.kv32
```kconfig
# Copyright (c) 2026 kv32 Project
# SPDX-License-Identifier: Apache-2.0

config CONSOLE_KV32
    bool "kv32 magic address console driver"
    help
      Enable console driver that writes to magic address 0xFFFFFFF4.
      This is useful for simulation/testbench where characters written
      to this address appear in the console output.

      This driver provides faster simulation performance compared to
      the full UART driver, as it bypasses hardware FIFO and baud rate
      timing simulation.

if CONSOLE_KV32

config CONSOLE_INIT_PRIORITY
    default 40

endif # CONSOLE_KV32
```

## rtos/zephyr/drivers/serial/Kconfig.kcore
```kconfig
# Copyright (c) 2026 kcore Project
# SPDX-License-Identifier: Apache-2.0

config UART_KCORE
    bool "kcore UART driver"
    default y
    depends on DT_HAS_KCORE_UART_ENABLED
    select SERIAL_HAS_DRIVER
    select SERIAL_SUPPORT_INTERRUPT
    help
      Enable driver for kcore custom UART peripheral.
      This UART has TX capability with a 16-entry FIFO.

if UART_KCORE

config UART_KCORE_PORT_0
    bool "Enable UART Port 0"
    default y
    help
      Enable UART port 0 (the main console UART).

endif # UART_KCORE
```

## rtos/zephyr/drivers/serial/Kconfig.kv32
```kconfig
# Copyright (c) 2026 kv32 Project
# SPDX-License-Identifier: Apache-2.0

config UART_KV32
    bool "kv32 UART driver"
    default y
    depends on DT_HAS_KV32_UART_ENABLED
    select SERIAL_HAS_DRIVER
    select SERIAL_SUPPORT_INTERRUPT
    help
      Enable driver for kv32 custom UART peripheral.
      This UART has TX capability with a 16-entry FIFO.

if UART_KV32

config UART_KV32_PORT_0
    bool "Enable UART Port 0"
    default y
    help
      Enable UART port 0 (the main console UART).

endif # UART_KV32
```

## rtos/zephyr/dts/bindings/serial/kcore,uart.yaml
```yaml
# Copyright (c) 2026 kcore Project
# SPDX-License-Identifier: Apache-2.0

description: kcore UART controller

compatible: "kcore,uart"

include: uart-controller.yaml

properties:
  reg:
    required: true

  clock-frequency:
    type: int
    required: true
    description: UART controller clock frequency in Hz

  current-speed:
    type: int
    required: true
    description: Initial baud rate setting for UART
```

## rtos/zephyr/dts/bindings/serial/kv32,uart.yaml
```yaml
# Copyright (c) 2026 kv32 Project
# SPDX-License-Identifier: Apache-2.0

description: kv32 UART controller

compatible: "kv32,uart"

include: uart-controller.yaml

properties:
  reg:
    required: true

  clock-frequency:
    type: int
    required: true
    description: UART controller clock frequency in Hz

  current-speed:
    type: int
    required: true
    description: Initial baud rate setting for UART
```

## rtos/zephyr/soc/riscv/kcore/Kconfig.defconfig
```kconfig
# Copyright (c) 2026 kcore Project
# SPDX-License-Identifier: Apache-2.0

if SOC_RISCV_KCORE

config SOC
    default "kcore"

config SYS_CLOCK_HW_CYCLES_PER_SEC
    default 50000000

# Console
config CONSOLE
    default y

config UART_CONSOLE
    default y

config SERIAL
    default y

# Minimal footprint
config MAIN_STACK_SIZE
    default 2048

config IDLE_STACK_SIZE
    default 512

config ISR_STACK_SIZE
    default 2048

endif # SOC_RISCV_KCORE
```

## rtos/zephyr/soc/riscv/kcore/Kconfig.soc
```kconfig
# Copyright (c) 2026 kcore Project
# SPDX-License-Identifier: Apache-2.0

config SOC_RISCV_KCORE
    bool "RISC-V kcore SoC"
    select RISCV
    select RISCV_PRIVILEGED
    select RISCV_ISA_RV32I
    select RISCV_ISA_EXT_M
    select RISCV_ISA_EXT_ZICSR
    select RISCV_ISA_EXT_ZIFENCEI
    select RISCV_HAS_CPU_IDLE
    help
      Enable support for the custom RISC-V RV32IM kcore SoC.
      This is a 5-stage pipelined processor with:
      - RV32I base integer instruction set
      - M extension (multiply/divide)
      - 2MB RAM
      - Custom UART peripheral
      - CLINT timer/interrupt controller

config SOC
    default "kcore" if SOC_RISCV_KCORE

config SYS_CLOCK_HW_CYCLES_PER_SEC
    default 50000000 if SOC_RISCV_KCORE

config RISCV_SOC_INTERRUPT_INIT
    default y if SOC_RISCV_KCORE

config NUM_IRQS
    default 32 if SOC_RISCV_KCORE

config RISCV_HAS_CPU_IDLE
    bool
    default y if SOC_RISCV_KCORE

# Enable RISCV_MACHINE_TIMER for sys_clock
config RISCV_MACHINE_TIMER
    bool
    default y if SOC_RISCV_KCORE
```

## rtos/zephyr/soc/riscv/kv32/Kconfig.defconfig
```kconfig
# Copyright (c) 2026 kv32 Project
# SPDX-License-Identifier: Apache-2.0

if SOC_RISCV_KV32

config SOC
    default "kv32"

config SYS_CLOCK_HW_CYCLES_PER_SEC
    default 50000000

# Console
config CONSOLE
    default y

config UART_CONSOLE
    default y

config SERIAL
    default y

# Minimal footprint
config MAIN_STACK_SIZE
    default 2048

config IDLE_STACK_SIZE
    default 512

config ISR_STACK_SIZE
    default 2048

endif # SOC_RISCV_KV32
```

## rtos/zephyr/soc/riscv/kv32/Kconfig.soc
```kconfig
# Copyright (c) 2026 kv32 Project
# SPDX-License-Identifier: Apache-2.0

config SOC_RISCV_KV32
    bool "RISC-V kv32 SoC"
    select RISCV
    select RISCV_PRIVILEGED
    select RISCV_ISA_RV32I
    select RISCV_ISA_EXT_M
    select RISCV_ISA_EXT_ZICSR
    select RISCV_ISA_EXT_ZIFENCEI
    select RISCV_HAS_CPU_IDLE
    help
      Enable support for the custom RISC-V RV32IM kv32 SoC.
      This is a 5-stage pipelined processor with:
      - RV32I base integer instruction set
      - M extension (multiply/divide)
      - 2MB RAM
      - Custom UART peripheral
      - CLINT timer/interrupt controller

config SOC
    default "kv32" if SOC_RISCV_KV32

config SYS_CLOCK_HW_CYCLES_PER_SEC
    default 50000000 if SOC_RISCV_KV32

config RISCV_SOC_INTERRUPT_INIT
    default y if SOC_RISCV_KV32

config NUM_IRQS
    default 32 if SOC_RISCV_KV32

config RISCV_HAS_CPU_IDLE
    bool
    default y if SOC_RISCV_KV32

# Enable RISCV_MACHINE_TIMER for sys_clock
config RISCV_MACHINE_TIMER
    bool
    default y if SOC_RISCV_KV32
```
